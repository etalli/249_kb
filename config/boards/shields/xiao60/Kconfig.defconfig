## config/boards/shields/xiao60/Kconfig.defconfig
```kconfig
# Default keyboard name for xiao60
if SHIELD_XIAO60
config ZMK_KEYBOARD_NAME
    default "xiao60"
endif
```

## config/boards/shields/xiao60/Kconfig.shield
```kconfig
# xiao60 shield Kconfig
config SHIELD_XIAO60
    def_bool $(shields_list_contains,xiao60)
```
